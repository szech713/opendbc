VERSION ""

NS_ :

BS_:

BU_: XXX

BO_ 55 NEW_MSG_1: 8 XXX

BO_ 258 NEW_MSG_2: 8 XXX

BO_ 658 NEW_MSG_3: 8 XXX

BO_ 993 Counter: 8 XXX
 SG_ Counter : 36|5@0+ (1,0) [0|31] "" XXX

BO_ 676 NEW_MSG_4: 8 XXX
 SG_ Counter : 55|4@0+ (1,0) [0|15] "" XXX

BO_ 384 NEW_MSG_5: 8 XXX

BO_ 746 NEW_MSG_6: 8 XXX

BO_ 352 NEW_MSG_7: 8 XXX

BO_ 292 NEW_MSG_8: 8 XXX

BO_ 290 NEW_MSG_9: 8 XXX

BO_ 181 NEW_MSG_10: 8 XXX
 SG_ NEW_SIGNAL_1 : 16|4@1+ (1,0) [0|15] "" XXX

BO_ 264 NEW_MSG_11: 8 XXX
