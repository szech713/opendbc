VERSION ""

NS_ :

BS_:

BU_:
VAL_TABLE_ AC_Switch 10 "Off" 9 "On" ;
VAL_TABLE_ GearPos 10 "Park" 9 "Neutral" 8 "Reverse" 4 "Drive" 3 "2nd" 2 "1st" ;
VAL_TABLE_ PRNDL 9 "Park / Neutral" 8 "Reverse" 2 "Drive / 2 / 1" ;
VAL_TABLE_ Brake_status 4 "On" 0 "Off" ;

BO_ 288 Engine: 3 Vector__XXX
 SG_ EngRPM : 8|16@1- (1,0) [0|0] "" Vector__XXX

BO_ 896 AC: 1 Vector__XXX
 SG_ AC_Switch : 0|8@1- (1,0) [0|0] "" Vector__XXX

BO_ 800 Trans: 1 Vector__XXX
 SG_ GearPos : 32|8@1- (1,0) [0|0] "" Vector__XXX

BO_ 768 Brake: 6 Vector__XXX
 SG_ PRNDL : 16|8@1- (1,0) [0|0] "" Vector__XXX
 SG_ Brake_status : 40|8@1- (1,0) [0|0] "" Vector__XXX

BA_DEF_  "BusType" STRING ;
BA_DEF_DEF_  "BusType" "CAN";
VAL_ 896 AC_Switch 10 "Off" 9 "On" ;
VAL_ 800 GearPos 10 "Park" 9 "Neutral" 8 "Reverse" 4 "Drive" 3 "2nd" 2 "1st" ;
VAL_ 768 PRNDL 9 "Park / Neutral" 8 "Reverse" 2 "Drive / 2 / 1" ;
VAL_ 768 Brake_status 4 "On" 0 "Off" ;
